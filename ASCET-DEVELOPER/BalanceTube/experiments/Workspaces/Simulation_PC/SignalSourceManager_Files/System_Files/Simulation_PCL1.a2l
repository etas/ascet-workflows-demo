ASAP2_VERSION 1 41
/begin PROJECT Simulation_PC "Generated by ETAS from Project Simulation_PC"
/begin HEADER "" VERSION "000" PROJECT_NO ASD /end HEADER
/begin MODULE Simulation_PC "Generated by ETAS ASCET7 from Project: Simulation_PC"
/begin IF_DATA E_TARGET
 /begin SOURCE "Task0" 3 /* period */ 10 QP_BLOB 1 /end SOURCE
 /begin TP_BLOB /* programm id */ 899210532 /* target id */ 7 0 2 0 /end TP_BLOB
/end IF_DATA
/begin MOD_PAR "" VERSION "000" ADDR_EPK 0x0 EPK "" SUPPLIER "ETAS GmbH" CUSTOMER "xxx" CUSTOMER_NO "000" USER "xxx" PHONE_NO "000" ECU "PC" CPU_TYPE "PCx86" NO_OF_INTERFACES 1 /end MOD_PAR
/begin MOD_COMMON "Common definitions" BYTE_ORDER MSB_LAST ALIGNMENT_BYTE 1 ALIGNMENT_WORD 2 ALIGNMENT_LONG 4 ALIGNMENT_FLOAT32_IEEE 4 ALIGNMENT_FLOAT64_IEEE 8 /end MOD_COMMON
/begin CHARACTERISTIC simulation.Stimulator.handPosition "" VALUE 0x0 STANDARD_VALUE_R64 0.0 esdl_ident -1.7976931348623157E+308 1.7976931348623157E+308 /end CHARACTERISTIC
/begin CHARACTERISTIC simulation.Stimulator.startGameButton "" VALUE 0x0 STANDARD_VALUE_U8 0.0 esdl_ident 0 1 BIT_MASK 0x1 /end CHARACTERISTIC
/begin CHARACTERISTIC simulation.Stimulator.autoModeButton "" VALUE 0x0 STANDARD_VALUE_U8 0.0 esdl_ident 0 1 BIT_MASK 0x1 /end CHARACTERISTIC
/begin MEASUREMENT simulation.Stimulator.ballPosition "" FLOAT64_IEEE esdl_ident 1 100.0 -1.7976931348623157E+308 1.7976931348623157E+308 ECU_ADDRESS 0x0 /end MEASUREMENT
/begin CHARACTERISTIC simulation.Stimulator.velocityCoefficient "" VALUE 0x0 STANDARD_VALUE_R64 0.0 esdl_ident -1.7976931348623157E+308 1.7976931348623157E+308 /end CHARACTERISTIC
/begin MEASUREMENT simulation.Stimulator.rightEdge "" UBYTE esdl_ident 1 100.0 0 1 ECU_ADDRESS 0x0 BIT_MASK 0x1 /end MEASUREMENT
/begin MEASUREMENT simulation.Stimulator.leftEdge "" UBYTE esdl_ident 1 100.0 0 1 ECU_ADDRESS 0x0 BIT_MASK 0x1 /end MEASUREMENT
/begin MEASUREMENT model.MainClass.gameController.sm "" UBYTE esdl_model_GameControllerStatemachineStates 1 100.0 0 3 ECU_ADDRESS 0x0 /end MEASUREMENT
/begin MEASUREMENT model.MainClass.gameController.timer.timeCounter "" FLOAT64_IEEE esdl_ident 1 100.0 -1.7976931348623157E+308 1.7976931348623157E+308 ECU_ADDRESS 0x0 /end MEASUREMENT
/begin MEASUREMENT model.MainClass.gameController.stopWatch.timeCounter "" FLOAT64_IEEE esdl_ident 1 100.0 -1.7976931348623157E+308 1.7976931348623157E+308 ECU_ADDRESS 0x0 /end MEASUREMENT
/begin MEASUREMENT model.MainClass.gameController.edgeDetect.buffer "" UBYTE esdl_ident 1 100.0 0 1 ECU_ADDRESS 0x0 BIT_MASK 0x1 /end MEASUREMENT
/begin MEASUREMENT model.MainClass.gameController.edgeDetect.oldSignal "" UBYTE esdl_ident 1 100.0 0 1 ECU_ADDRESS 0x0 BIT_MASK 0x1 /end MEASUREMENT
/begin CHARACTERISTIC model.MainClass.gameController.gameTime "" VALUE 0x0 STANDARD_VALUE_R64 0.0 esdl_ident -1.7976931348623157E+308 1.7976931348623157E+308 /end CHARACTERISTIC
/begin CHARACTERISTIC model.MainClass.gameController.scoringZone "" VALUE 0x0 STANDARD_VALUE_R64 0.0 esdl_ident -1.7976931348623157E+308 1.7976931348623157E+308 /end CHARACTERISTIC
/begin MEASUREMENT model.MainClass.gameController.ballPosition "" FLOAT64_IEEE esdl_ident 1 100.0 -1.7976931348623157E+308 1.7976931348623157E+308 ECU_ADDRESS 0x0 /end MEASUREMENT
/begin MEASUREMENT model.MainClass.gameController.startGame "" UBYTE esdl_ident 1 100.0 0 1 ECU_ADDRESS 0x0 BIT_MASK 0x1 /end MEASUREMENT
/begin MEASUREMENT model.MainClass.gameController.score "" FLOAT64_IEEE esdl_ident 1 100.0 -1.7976931348623157E+308 1.7976931348623157E+308 ECU_ADDRESS 0x0 /end MEASUREMENT
/begin MEASUREMENT model.MainClass.ledController.sm "" UBYTE esdl_model_LedControllerStatemachineStates 1 100.0 0 1 ECU_ADDRESS 0x0 /end MEASUREMENT
/begin MEASUREMENT model.MainClass.ledController.gameState "" UBYTE esdl_model_GameControllerStatemachineStates 1 100.0 0 3 ECU_ADDRESS 0x0 /end MEASUREMENT
/begin MEASUREMENT model.MainClass.ledController.gameTime "" FLOAT64_IEEE esdl_ident 1 100.0 -1.7976931348623157E+308 1.7976931348623157E+308 ECU_ADDRESS 0x0 /end MEASUREMENT
/begin MEASUREMENT model.MainClass.ledController.ledRing[0].red "" FLOAT64_IEEE esdl_ident 1 100.0 -1.7976931348623157E+308 1.7976931348623157E+308 ECU_ADDRESS 0x0 /end MEASUREMENT
/begin MEASUREMENT model.MainClass.ledController.ledRing[0].green "" FLOAT64_IEEE esdl_ident 1 100.0 -1.7976931348623157E+308 1.7976931348623157E+308 ECU_ADDRESS 0x0 /end MEASUREMENT
/begin MEASUREMENT model.MainClass.ledController.ledRing[0].blue "" FLOAT64_IEEE esdl_ident 1 100.0 -1.7976931348623157E+308 1.7976931348623157E+308 ECU_ADDRESS 0x0 /end MEASUREMENT
/begin MEASUREMENT model.MainClass.ledController.ledRing[1].red "" FLOAT64_IEEE esdl_ident 1 100.0 -1.7976931348623157E+308 1.7976931348623157E+308 ECU_ADDRESS 0x0 /end MEASUREMENT
/begin MEASUREMENT model.MainClass.ledController.ledRing[1].green "" FLOAT64_IEEE esdl_ident 1 100.0 -1.7976931348623157E+308 1.7976931348623157E+308 ECU_ADDRESS 0x0 /end MEASUREMENT
/begin MEASUREMENT model.MainClass.ledController.ledRing[1].blue "" FLOAT64_IEEE esdl_ident 1 100.0 -1.7976931348623157E+308 1.7976931348623157E+308 ECU_ADDRESS 0x0 /end MEASUREMENT
/begin MEASUREMENT model.MainClass.ledController.ledRing[2].red "" FLOAT64_IEEE esdl_ident 1 100.0 -1.7976931348623157E+308 1.7976931348623157E+308 ECU_ADDRESS 0x0 /end MEASUREMENT
/begin MEASUREMENT model.MainClass.ledController.ledRing[2].green "" FLOAT64_IEEE esdl_ident 1 100.0 -1.7976931348623157E+308 1.7976931348623157E+308 ECU_ADDRESS 0x0 /end MEASUREMENT
/begin MEASUREMENT model.MainClass.ledController.ledRing[2].blue "" FLOAT64_IEEE esdl_ident 1 100.0 -1.7976931348623157E+308 1.7976931348623157E+308 ECU_ADDRESS 0x0 /end MEASUREMENT
/begin MEASUREMENT model.MainClass.ledController.ledRing[3].red "" FLOAT64_IEEE esdl_ident 1 100.0 -1.7976931348623157E+308 1.7976931348623157E+308 ECU_ADDRESS 0x0 /end MEASUREMENT
/begin MEASUREMENT model.MainClass.ledController.ledRing[3].green "" FLOAT64_IEEE esdl_ident 1 100.0 -1.7976931348623157E+308 1.7976931348623157E+308 ECU_ADDRESS 0x0 /end MEASUREMENT
/begin MEASUREMENT model.MainClass.ledController.ledRing[3].blue "" FLOAT64_IEEE esdl_ident 1 100.0 -1.7976931348623157E+308 1.7976931348623157E+308 ECU_ADDRESS 0x0 /end MEASUREMENT
/begin MEASUREMENT model.MainClass.ledController.ledRing[4].red "" FLOAT64_IEEE esdl_ident 1 100.0 -1.7976931348623157E+308 1.7976931348623157E+308 ECU_ADDRESS 0x0 /end MEASUREMENT
/begin MEASUREMENT model.MainClass.ledController.ledRing[4].green "" FLOAT64_IEEE esdl_ident 1 100.0 -1.7976931348623157E+308 1.7976931348623157E+308 ECU_ADDRESS 0x0 /end MEASUREMENT
/begin MEASUREMENT model.MainClass.ledController.ledRing[4].blue "" FLOAT64_IEEE esdl_ident 1 100.0 -1.7976931348623157E+308 1.7976931348623157E+308 ECU_ADDRESS 0x0 /end MEASUREMENT
/begin MEASUREMENT model.MainClass.ledController.ledRing[5].red "" FLOAT64_IEEE esdl_ident 1 100.0 -1.7976931348623157E+308 1.7976931348623157E+308 ECU_ADDRESS 0x0 /end MEASUREMENT
/begin MEASUREMENT model.MainClass.ledController.ledRing[5].green "" FLOAT64_IEEE esdl_ident 1 100.0 -1.7976931348623157E+308 1.7976931348623157E+308 ECU_ADDRESS 0x0 /end MEASUREMENT
/begin MEASUREMENT model.MainClass.ledController.ledRing[5].blue "" FLOAT64_IEEE esdl_ident 1 100.0 -1.7976931348623157E+308 1.7976931348623157E+308 ECU_ADDRESS 0x0 /end MEASUREMENT
/begin MEASUREMENT model.MainClass.ledController.ledRing[6].red "" FLOAT64_IEEE esdl_ident 1 100.0 -1.7976931348623157E+308 1.7976931348623157E+308 ECU_ADDRESS 0x0 /end MEASUREMENT
/begin MEASUREMENT model.MainClass.ledController.ledRing[6].green "" FLOAT64_IEEE esdl_ident 1 100.0 -1.7976931348623157E+308 1.7976931348623157E+308 ECU_ADDRESS 0x0 /end MEASUREMENT
/begin MEASUREMENT model.MainClass.ledController.ledRing[6].blue "" FLOAT64_IEEE esdl_ident 1 100.0 -1.7976931348623157E+308 1.7976931348623157E+308 ECU_ADDRESS 0x0 /end MEASUREMENT
/begin MEASUREMENT model.MainClass.ledController.ledRing[7].red "" FLOAT64_IEEE esdl_ident 1 100.0 -1.7976931348623157E+308 1.7976931348623157E+308 ECU_ADDRESS 0x0 /end MEASUREMENT
/begin MEASUREMENT model.MainClass.ledController.ledRing[7].green "" FLOAT64_IEEE esdl_ident 1 100.0 -1.7976931348623157E+308 1.7976931348623157E+308 ECU_ADDRESS 0x0 /end MEASUREMENT
/begin MEASUREMENT model.MainClass.ledController.ledRing[7].blue "" FLOAT64_IEEE esdl_ident 1 100.0 -1.7976931348623157E+308 1.7976931348623157E+308 ECU_ADDRESS 0x0 /end MEASUREMENT
/begin MEASUREMENT model.MainClass.ledController.ledRing[8].red "" FLOAT64_IEEE esdl_ident 1 100.0 -1.7976931348623157E+308 1.7976931348623157E+308 ECU_ADDRESS 0x0 /end MEASUREMENT
/begin MEASUREMENT model.MainClass.ledController.ledRing[8].green "" FLOAT64_IEEE esdl_ident 1 100.0 -1.7976931348623157E+308 1.7976931348623157E+308 ECU_ADDRESS 0x0 /end MEASUREMENT
/begin MEASUREMENT model.MainClass.ledController.ledRing[8].blue "" FLOAT64_IEEE esdl_ident 1 100.0 -1.7976931348623157E+308 1.7976931348623157E+308 ECU_ADDRESS 0x0 /end MEASUREMENT
/begin MEASUREMENT model.MainClass.ledController.ledRing[9].red "" FLOAT64_IEEE esdl_ident 1 100.0 -1.7976931348623157E+308 1.7976931348623157E+308 ECU_ADDRESS 0x0 /end MEASUREMENT
/begin MEASUREMENT model.MainClass.ledController.ledRing[9].green "" FLOAT64_IEEE esdl_ident 1 100.0 -1.7976931348623157E+308 1.7976931348623157E+308 ECU_ADDRESS 0x0 /end MEASUREMENT
/begin MEASUREMENT model.MainClass.ledController.ledRing[9].blue "" FLOAT64_IEEE esdl_ident 1 100.0 -1.7976931348623157E+308 1.7976931348623157E+308 ECU_ADDRESS 0x0 /end MEASUREMENT
/begin MEASUREMENT model.MainClass.ledController.ledRing[10].red "" FLOAT64_IEEE esdl_ident 1 100.0 -1.7976931348623157E+308 1.7976931348623157E+308 ECU_ADDRESS 0x0 /end MEASUREMENT
/begin MEASUREMENT model.MainClass.ledController.ledRing[10].green "" FLOAT64_IEEE esdl_ident 1 100.0 -1.7976931348623157E+308 1.7976931348623157E+308 ECU_ADDRESS 0x0 /end MEASUREMENT
/begin MEASUREMENT model.MainClass.ledController.ledRing[10].blue "" FLOAT64_IEEE esdl_ident 1 100.0 -1.7976931348623157E+308 1.7976931348623157E+308 ECU_ADDRESS 0x0 /end MEASUREMENT
/begin MEASUREMENT model.MainClass.ledController.ledRing[11].red "" FLOAT64_IEEE esdl_ident 1 100.0 -1.7976931348623157E+308 1.7976931348623157E+308 ECU_ADDRESS 0x0 /end MEASUREMENT
/begin MEASUREMENT model.MainClass.ledController.ledRing[11].green "" FLOAT64_IEEE esdl_ident 1 100.0 -1.7976931348623157E+308 1.7976931348623157E+308 ECU_ADDRESS 0x0 /end MEASUREMENT
/begin MEASUREMENT model.MainClass.ledController.ledRing[11].blue "" FLOAT64_IEEE esdl_ident 1 100.0 -1.7976931348623157E+308 1.7976931348623157E+308 ECU_ADDRESS 0x0 /end MEASUREMENT
/begin MEASUREMENT model.MainClass.ledController.fadeValue "" FLOAT64_IEEE esdl_ident 1 100.0 -1.7976931348623157E+308 1.7976931348623157E+308 ECU_ADDRESS 0x0 /end MEASUREMENT
/begin MEASUREMENT model.MainClass.ledController.sw.timeCounter "" FLOAT64_IEEE esdl_ident 1 100.0 -1.7976931348623157E+308 1.7976931348623157E+308 ECU_ADDRESS 0x0 /end MEASUREMENT
/begin MEASUREMENT model.MainClass.servoController.sm "" UBYTE esdl_model_ServoControllerStatemachineStates 1 100.0 0 3 ECU_ADDRESS 0x0 /end MEASUREMENT
/begin MEASUREMENT model.MainClass.servoController.gameState "" UBYTE esdl_model_GameControllerStatemachineStates 1 100.0 0 3 ECU_ADDRESS 0x0 /end MEASUREMENT
/begin MEASUREMENT model.MainClass.servoController.edgeDetect.buffer "" UBYTE esdl_ident 1 100.0 0 1 ECU_ADDRESS 0x0 BIT_MASK 0x1 /end MEASUREMENT
/begin MEASUREMENT model.MainClass.servoController.edgeDetect.oldSignal "" UBYTE esdl_ident 1 100.0 0 1 ECU_ADDRESS 0x0 BIT_MASK 0x1 /end MEASUREMENT
/begin MEASUREMENT model.MainClass.servoController.switchMode "" UBYTE esdl_ident 1 100.0 0 1 ECU_ADDRESS 0x0 BIT_MASK 0x1 /end MEASUREMENT
/begin MEASUREMENT model.MainClass.servoController.ballPosition "" FLOAT64_IEEE esdl_ident 1 100.0 -1.7976931348623157E+308 1.7976931348623157E+308 ECU_ADDRESS 0x0 /end MEASUREMENT
/begin MEASUREMENT model.MainClass.servoController.handPosition "" FLOAT64_IEEE esdl_ident 1 100.0 -1.7976931348623157E+308 1.7976931348623157E+308 ECU_ADDRESS 0x0 /end MEASUREMENT
/begin MEASUREMENT model.MainClass.servoController.servoPosition "" FLOAT64_IEEE esdl_ident 1 100.0 -1.7976931348623157E+308 1.7976931348623157E+308 ECU_ADDRESS 0x0 /end MEASUREMENT
/begin CHARACTERISTIC model.MainClass.servoController.kp "" VALUE 0x0 STANDARD_VALUE_R64 0.0 esdl_ident -1.7976931348623157E+308 1.7976931348623157E+308 /end CHARACTERISTIC
/begin CHARACTERISTIC model.MainClass.servoController.ki "" VALUE 0x0 STANDARD_VALUE_R64 0.0 esdl_ident -1.7976931348623157E+308 1.7976931348623157E+308 /end CHARACTERISTIC
/begin MEASUREMENT model.MainClass.servoController.doIntegrate "" UBYTE esdl_ident 1 100.0 0 1 ECU_ADDRESS 0x0 BIT_MASK 0x1 /end MEASUREMENT
/begin MEASUREMENT model.MainClass.servoController.error "" FLOAT64_IEEE esdl_ident 1 100.0 -1.7976931348623157E+308 1.7976931348623157E+308 ECU_ADDRESS 0x0 /end MEASUREMENT
/begin MEASUREMENT model.MainClass.servoController.integral "" FLOAT64_IEEE esdl_ident 1 100.0 -1.7976931348623157E+308 1.7976931348623157E+308 ECU_ADDRESS 0x0 /end MEASUREMENT
/begin MEASUREMENT model.MainClass.servoController.lastValue "" FLOAT64_IEEE esdl_ident 1 100.0 -1.7976931348623157E+308 1.7976931348623157E+308 ECU_ADDRESS 0x0 /end MEASUREMENT
/begin CHARACTERISTIC model.MainClass.servoController.kd "" VALUE 0x0 STANDARD_VALUE_R64 0.0 esdl_ident -1.7976931348623157E+308 1.7976931348623157E+308 /end CHARACTERISTIC
/begin MEASUREMENT model.Signals.adcHandPosition "" FLOAT64_IEEE esdl_ident 1 100.0 -1.7976931348623157E+308 1.7976931348623157E+308 ECU_ADDRESS 0x0 /end MEASUREMENT
/begin MEASUREMENT model.Signals.score "" FLOAT64_IEEE esdl_ident 1 100.0 -1.7976931348623157E+308 1.7976931348623157E+308 ECU_ADDRESS 0x0 /end MEASUREMENT
/begin MEASUREMENT model.Signals.ballPosition "" FLOAT64_IEEE esdl_ident 1 100.0 -1.7976931348623157E+308 1.7976931348623157E+308 ECU_ADDRESS 0x0 /end MEASUREMENT
/begin MEASUREMENT model.Signals.handPosition "" FLOAT64_IEEE esdl_ident 1 100.0 -1.7976931348623157E+308 1.7976931348623157E+308 ECU_ADDRESS 0x0 /end MEASUREMENT
/begin MEASUREMENT model.Signals.servoPosition "" FLOAT64_IEEE esdl_ident 1 100.0 -1.7976931348623157E+308 1.7976931348623157E+308 ECU_ADDRESS 0x0 /end MEASUREMENT
/begin MEASUREMENT model.Signals.startGameButton "" UBYTE esdl_ident 1 100.0 0 1 ECU_ADDRESS 0x0 BIT_MASK 0x1 /end MEASUREMENT
/begin MEASUREMENT model.Signals.autoModeButton "" UBYTE esdl_ident 1 100.0 0 1 ECU_ADDRESS 0x0 BIT_MASK 0x1 /end MEASUREMENT
/begin MEASUREMENT model.Signals.ledRing[0].red "" FLOAT64_IEEE esdl_ident 1 100.0 -1.7976931348623157E+308 1.7976931348623157E+308 ECU_ADDRESS 0x0 /end MEASUREMENT
/begin MEASUREMENT model.Signals.ledRing[0].green "" FLOAT64_IEEE esdl_ident 1 100.0 -1.7976931348623157E+308 1.7976931348623157E+308 ECU_ADDRESS 0x0 /end MEASUREMENT
/begin MEASUREMENT model.Signals.ledRing[0].blue "" FLOAT64_IEEE esdl_ident 1 100.0 -1.7976931348623157E+308 1.7976931348623157E+308 ECU_ADDRESS 0x0 /end MEASUREMENT
/begin MEASUREMENT model.Signals.ledRing[1].red "" FLOAT64_IEEE esdl_ident 1 100.0 -1.7976931348623157E+308 1.7976931348623157E+308 ECU_ADDRESS 0x0 /end MEASUREMENT
/begin MEASUREMENT model.Signals.ledRing[1].green "" FLOAT64_IEEE esdl_ident 1 100.0 -1.7976931348623157E+308 1.7976931348623157E+308 ECU_ADDRESS 0x0 /end MEASUREMENT
/begin MEASUREMENT model.Signals.ledRing[1].blue "" FLOAT64_IEEE esdl_ident 1 100.0 -1.7976931348623157E+308 1.7976931348623157E+308 ECU_ADDRESS 0x0 /end MEASUREMENT
/begin MEASUREMENT model.Signals.ledRing[2].red "" FLOAT64_IEEE esdl_ident 1 100.0 -1.7976931348623157E+308 1.7976931348623157E+308 ECU_ADDRESS 0x0 /end MEASUREMENT
/begin MEASUREMENT model.Signals.ledRing[2].green "" FLOAT64_IEEE esdl_ident 1 100.0 -1.7976931348623157E+308 1.7976931348623157E+308 ECU_ADDRESS 0x0 /end MEASUREMENT
/begin MEASUREMENT model.Signals.ledRing[2].blue "" FLOAT64_IEEE esdl_ident 1 100.0 -1.7976931348623157E+308 1.7976931348623157E+308 ECU_ADDRESS 0x0 /end MEASUREMENT
/begin MEASUREMENT model.Signals.ledRing[3].red "" FLOAT64_IEEE esdl_ident 1 100.0 -1.7976931348623157E+308 1.7976931348623157E+308 ECU_ADDRESS 0x0 /end MEASUREMENT
/begin MEASUREMENT model.Signals.ledRing[3].green "" FLOAT64_IEEE esdl_ident 1 100.0 -1.7976931348623157E+308 1.7976931348623157E+308 ECU_ADDRESS 0x0 /end MEASUREMENT
/begin MEASUREMENT model.Signals.ledRing[3].blue "" FLOAT64_IEEE esdl_ident 1 100.0 -1.7976931348623157E+308 1.7976931348623157E+308 ECU_ADDRESS 0x0 /end MEASUREMENT
/begin MEASUREMENT model.Signals.ledRing[4].red "" FLOAT64_IEEE esdl_ident 1 100.0 -1.7976931348623157E+308 1.7976931348623157E+308 ECU_ADDRESS 0x0 /end MEASUREMENT
/begin MEASUREMENT model.Signals.ledRing[4].green "" FLOAT64_IEEE esdl_ident 1 100.0 -1.7976931348623157E+308 1.7976931348623157E+308 ECU_ADDRESS 0x0 /end MEASUREMENT
/begin MEASUREMENT model.Signals.ledRing[4].blue "" FLOAT64_IEEE esdl_ident 1 100.0 -1.7976931348623157E+308 1.7976931348623157E+308 ECU_ADDRESS 0x0 /end MEASUREMENT
/begin MEASUREMENT model.Signals.ledRing[5].red "" FLOAT64_IEEE esdl_ident 1 100.0 -1.7976931348623157E+308 1.7976931348623157E+308 ECU_ADDRESS 0x0 /end MEASUREMENT
/begin MEASUREMENT model.Signals.ledRing[5].green "" FLOAT64_IEEE esdl_ident 1 100.0 -1.7976931348623157E+308 1.7976931348623157E+308 ECU_ADDRESS 0x0 /end MEASUREMENT
/begin MEASUREMENT model.Signals.ledRing[5].blue "" FLOAT64_IEEE esdl_ident 1 100.0 -1.7976931348623157E+308 1.7976931348623157E+308 ECU_ADDRESS 0x0 /end MEASUREMENT
/begin MEASUREMENT model.Signals.ledRing[6].red "" FLOAT64_IEEE esdl_ident 1 100.0 -1.7976931348623157E+308 1.7976931348623157E+308 ECU_ADDRESS 0x0 /end MEASUREMENT
/begin MEASUREMENT model.Signals.ledRing[6].green "" FLOAT64_IEEE esdl_ident 1 100.0 -1.7976931348623157E+308 1.7976931348623157E+308 ECU_ADDRESS 0x0 /end MEASUREMENT
/begin MEASUREMENT model.Signals.ledRing[6].blue "" FLOAT64_IEEE esdl_ident 1 100.0 -1.7976931348623157E+308 1.7976931348623157E+308 ECU_ADDRESS 0x0 /end MEASUREMENT
/begin MEASUREMENT model.Signals.ledRing[7].red "" FLOAT64_IEEE esdl_ident 1 100.0 -1.7976931348623157E+308 1.7976931348623157E+308 ECU_ADDRESS 0x0 /end MEASUREMENT
/begin MEASUREMENT model.Signals.ledRing[7].green "" FLOAT64_IEEE esdl_ident 1 100.0 -1.7976931348623157E+308 1.7976931348623157E+308 ECU_ADDRESS 0x0 /end MEASUREMENT
/begin MEASUREMENT model.Signals.ledRing[7].blue "" FLOAT64_IEEE esdl_ident 1 100.0 -1.7976931348623157E+308 1.7976931348623157E+308 ECU_ADDRESS 0x0 /end MEASUREMENT
/begin MEASUREMENT model.Signals.ledRing[8].red "" FLOAT64_IEEE esdl_ident 1 100.0 -1.7976931348623157E+308 1.7976931348623157E+308 ECU_ADDRESS 0x0 /end MEASUREMENT
/begin MEASUREMENT model.Signals.ledRing[8].green "" FLOAT64_IEEE esdl_ident 1 100.0 -1.7976931348623157E+308 1.7976931348623157E+308 ECU_ADDRESS 0x0 /end MEASUREMENT
/begin MEASUREMENT model.Signals.ledRing[8].blue "" FLOAT64_IEEE esdl_ident 1 100.0 -1.7976931348623157E+308 1.7976931348623157E+308 ECU_ADDRESS 0x0 /end MEASUREMENT
/begin MEASUREMENT model.Signals.ledRing[9].red "" FLOAT64_IEEE esdl_ident 1 100.0 -1.7976931348623157E+308 1.7976931348623157E+308 ECU_ADDRESS 0x0 /end MEASUREMENT
/begin MEASUREMENT model.Signals.ledRing[9].green "" FLOAT64_IEEE esdl_ident 1 100.0 -1.7976931348623157E+308 1.7976931348623157E+308 ECU_ADDRESS 0x0 /end MEASUREMENT
/begin MEASUREMENT model.Signals.ledRing[9].blue "" FLOAT64_IEEE esdl_ident 1 100.0 -1.7976931348623157E+308 1.7976931348623157E+308 ECU_ADDRESS 0x0 /end MEASUREMENT
/begin MEASUREMENT model.Signals.ledRing[10].red "" FLOAT64_IEEE esdl_ident 1 100.0 -1.7976931348623157E+308 1.7976931348623157E+308 ECU_ADDRESS 0x0 /end MEASUREMENT
/begin MEASUREMENT model.Signals.ledRing[10].green "" FLOAT64_IEEE esdl_ident 1 100.0 -1.7976931348623157E+308 1.7976931348623157E+308 ECU_ADDRESS 0x0 /end MEASUREMENT
/begin MEASUREMENT model.Signals.ledRing[10].blue "" FLOAT64_IEEE esdl_ident 1 100.0 -1.7976931348623157E+308 1.7976931348623157E+308 ECU_ADDRESS 0x0 /end MEASUREMENT
/begin MEASUREMENT model.Signals.ledRing[11].red "" FLOAT64_IEEE esdl_ident 1 100.0 -1.7976931348623157E+308 1.7976931348623157E+308 ECU_ADDRESS 0x0 /end MEASUREMENT
/begin MEASUREMENT model.Signals.ledRing[11].green "" FLOAT64_IEEE esdl_ident 1 100.0 -1.7976931348623157E+308 1.7976931348623157E+308 ECU_ADDRESS 0x0 /end MEASUREMENT
/begin MEASUREMENT model.Signals.ledRing[11].blue "" FLOAT64_IEEE esdl_ident 1 100.0 -1.7976931348623157E+308 1.7976931348623157E+308 ECU_ADDRESS 0x0 /end MEASUREMENT
/begin COMPU_METHOD esdl_ident "" RAT_FUNC "%12.4" "" /* coeffs */ COEFFS 0 1 0 0 0 1 /end COMPU_METHOD
/begin COMPU_METHOD esdl_model_GameControllerStatemachineStates "" TAB_VERB "%12.4" "" COMPU_TAB_REF esdl_model_GameControllerStatemachineStates_vtab /end COMPU_METHOD
/begin COMPU_VTAB esdl_model_GameControllerStatemachineStates_vtab "" TAB_VERB 4 0 "Idle" 3 "GameRunning" 2 "NotInScoringZone" 1 "IncreaseScore" DEFAULT_VALUE "Error" /end COMPU_VTAB
/begin COMPU_METHOD esdl_model_LedControllerStatemachineStates "" TAB_VERB "%12.4" "" COMPU_TAB_REF esdl_model_LedControllerStatemachineStates_vtab /end COMPU_METHOD
/begin COMPU_VTAB esdl_model_LedControllerStatemachineStates_vtab "" TAB_VERB 2 0 "IdleFading" 1 "IndicateGameTime" DEFAULT_VALUE "Error" /end COMPU_VTAB
/begin COMPU_METHOD esdl_model_ServoControllerStatemachineStates "" TAB_VERB "%12.4" "" COMPU_TAB_REF esdl_model_ServoControllerStatemachineStates_vtab /end COMPU_METHOD
/begin COMPU_VTAB esdl_model_ServoControllerStatemachineStates_vtab "" TAB_VERB 4 2 "ManualMode" 1 "AutoMode" 3 "ControlPosition" 0 "IdlePosition" DEFAULT_VALUE "Error" /end COMPU_VTAB
/begin FUNCTION simulation.Stimulator ""
 /begin DEF_CHARACTERISTIC simulation.Stimulator.handPosition simulation.Stimulator.startGameButton simulation.Stimulator.autoModeButton simulation.Stimulator.velocityCoefficient /end DEF_CHARACTERISTIC
 /begin IN_MEASUREMENT model.Signals.servoPosition /end IN_MEASUREMENT
 /begin OUT_MEASUREMENT model.Signals.autoModeButton model.Signals.ballPosition model.Signals.handPosition model.Signals.startGameButton /end OUT_MEASUREMENT
 /begin LOC_MEASUREMENT simulation.Stimulator.ballPosition simulation.Stimulator.leftEdge simulation.Stimulator.rightEdge /end LOC_MEASUREMENT
/end FUNCTION
/begin FUNCTION model.MainClass ""
 /begin IN_MEASUREMENT model.Signals.autoModeButton model.Signals.ballPosition model.Signals.handPosition model.Signals.startGameButton /end IN_MEASUREMENT
 /begin OUT_MEASUREMENT model.Signals.ledRing model.Signals.score model.Signals.servoPosition /end OUT_MEASUREMENT
 /begin SUB_FUNCTION model.MainClass.gameController model.MainClass.ledController model.MainClass.servoController /end SUB_FUNCTION
/end FUNCTION
/begin FUNCTION model.MainClass.gameController ""
 /begin DEF_CHARACTERISTIC model.MainClass.gameController.gameTime model.MainClass.gameController.scoringZone /end DEF_CHARACTERISTIC
 /begin LOC_MEASUREMENT model.MainClass.gameController.ballPosition model.MainClass.gameController.score model.MainClass.gameController.sm model.MainClass.gameController.startGame /end LOC_MEASUREMENT
 /begin SUB_FUNCTION model.MainClass.gameController.timer model.MainClass.gameController.stopWatch model.MainClass.gameController.edgeDetect /end SUB_FUNCTION
/end FUNCTION
/begin FUNCTION model.MainClass.gameController.timer "Timer decrements the time counter by dT and signals when the time counter has reached zero. It is not retriggerable." /begin LOC_MEASUREMENT model.MainClass.gameController.timer.timeCounter /end LOC_MEASUREMENT /end FUNCTION
/begin FUNCTION model.MainClass.gameController.stopWatch "StopWatch increments the time counter by one dT." /begin LOC_MEASUREMENT model.MainClass.gameController.stopWatch.timeCounter /end LOC_MEASUREMENT /end FUNCTION
/begin FUNCTION model.MainClass.gameController.edgeDetect "EdgeRising detects a rising edge of the logical input signal."
 /begin LOC_MEASUREMENT model.MainClass.gameController.edgeDetect.buffer model.MainClass.gameController.edgeDetect.oldSignal /end LOC_MEASUREMENT
/end FUNCTION
/begin FUNCTION model.MainClass.ledController ""
 /begin LOC_MEASUREMENT model.MainClass.ledController.fadeValue model.MainClass.ledController.gameState model.MainClass.ledController.gameTime model.MainClass.ledController.sm /end LOC_MEASUREMENT
 /begin SUB_FUNCTION model.MainClass.ledController.ledRing[0] model.MainClass.ledController.ledRing[1] model.MainClass.ledController.ledRing[2] model.MainClass.ledController.ledRing[3] model.MainClass.ledController.ledRing[4] model.MainClass.ledController.ledRing[5] model.MainClass.ledController.ledRing[6] model.MainClass.ledController.ledRing[7] model.MainClass.ledController.ledRing[8] model.MainClass.ledController.ledRing[9] model.MainClass.ledController.ledRing[10] model.MainClass.ledController.ledRing[11] model.MainClass.ledController.sw /end SUB_FUNCTION
/end FUNCTION
/begin FUNCTION model.MainClass.ledController.ledRing[0] ""
 /begin LOC_MEASUREMENT model.MainClass.ledController.ledRing[0].blue model.MainClass.ledController.ledRing[0].green model.MainClass.ledController.ledRing[0].red /end LOC_MEASUREMENT
/end FUNCTION
/begin FUNCTION model.MainClass.ledController.ledRing[1] ""
 /begin LOC_MEASUREMENT model.MainClass.ledController.ledRing[1].blue model.MainClass.ledController.ledRing[1].green model.MainClass.ledController.ledRing[1].red /end LOC_MEASUREMENT
/end FUNCTION
/begin FUNCTION model.MainClass.ledController.ledRing[2] ""
 /begin LOC_MEASUREMENT model.MainClass.ledController.ledRing[2].blue model.MainClass.ledController.ledRing[2].green model.MainClass.ledController.ledRing[2].red /end LOC_MEASUREMENT
/end FUNCTION
/begin FUNCTION model.MainClass.ledController.ledRing[3] ""
 /begin LOC_MEASUREMENT model.MainClass.ledController.ledRing[3].blue model.MainClass.ledController.ledRing[3].green model.MainClass.ledController.ledRing[3].red /end LOC_MEASUREMENT
/end FUNCTION
/begin FUNCTION model.MainClass.ledController.ledRing[4] ""
 /begin LOC_MEASUREMENT model.MainClass.ledController.ledRing[4].blue model.MainClass.ledController.ledRing[4].green model.MainClass.ledController.ledRing[4].red /end LOC_MEASUREMENT
/end FUNCTION
/begin FUNCTION model.MainClass.ledController.ledRing[5] ""
 /begin LOC_MEASUREMENT model.MainClass.ledController.ledRing[5].blue model.MainClass.ledController.ledRing[5].green model.MainClass.ledController.ledRing[5].red /end LOC_MEASUREMENT
/end FUNCTION
/begin FUNCTION model.MainClass.ledController.ledRing[6] ""
 /begin LOC_MEASUREMENT model.MainClass.ledController.ledRing[6].blue model.MainClass.ledController.ledRing[6].green model.MainClass.ledController.ledRing[6].red /end LOC_MEASUREMENT
/end FUNCTION
/begin FUNCTION model.MainClass.ledController.ledRing[7] ""
 /begin LOC_MEASUREMENT model.MainClass.ledController.ledRing[7].blue model.MainClass.ledController.ledRing[7].green model.MainClass.ledController.ledRing[7].red /end LOC_MEASUREMENT
/end FUNCTION
/begin FUNCTION model.MainClass.ledController.ledRing[8] ""
 /begin LOC_MEASUREMENT model.MainClass.ledController.ledRing[8].blue model.MainClass.ledController.ledRing[8].green model.MainClass.ledController.ledRing[8].red /end LOC_MEASUREMENT
/end FUNCTION
/begin FUNCTION model.MainClass.ledController.ledRing[9] ""
 /begin LOC_MEASUREMENT model.MainClass.ledController.ledRing[9].blue model.MainClass.ledController.ledRing[9].green model.MainClass.ledController.ledRing[9].red /end LOC_MEASUREMENT
/end FUNCTION
/begin FUNCTION model.MainClass.ledController.ledRing[10] ""
 /begin LOC_MEASUREMENT model.MainClass.ledController.ledRing[10].blue model.MainClass.ledController.ledRing[10].green model.MainClass.ledController.ledRing[10].red /end LOC_MEASUREMENT
/end FUNCTION
/begin FUNCTION model.MainClass.ledController.ledRing[11] ""
 /begin LOC_MEASUREMENT model.MainClass.ledController.ledRing[11].blue model.MainClass.ledController.ledRing[11].green model.MainClass.ledController.ledRing[11].red /end LOC_MEASUREMENT
/end FUNCTION
/begin FUNCTION model.MainClass.ledController.sw "StopWatch increments the time counter by one dT." /begin LOC_MEASUREMENT model.MainClass.ledController.sw.timeCounter /end LOC_MEASUREMENT /end FUNCTION
/begin FUNCTION model.MainClass.servoController ""
 /begin DEF_CHARACTERISTIC model.MainClass.servoController.kp model.MainClass.servoController.ki model.MainClass.servoController.kd /end DEF_CHARACTERISTIC
 /begin LOC_MEASUREMENT model.MainClass.servoController.ballPosition model.MainClass.servoController.doIntegrate model.MainClass.servoController.error model.MainClass.servoController.gameState model.MainClass.servoController.handPosition model.MainClass.servoController.integral model.MainClass.servoController.lastValue model.MainClass.servoController.servoPosition model.MainClass.servoController.sm model.MainClass.servoController.switchMode /end LOC_MEASUREMENT
 /begin SUB_FUNCTION model.MainClass.servoController.edgeDetect /end SUB_FUNCTION
/end FUNCTION
/begin FUNCTION model.MainClass.servoController.edgeDetect "EdgeRising detects a rising edge of the logical input signal."
 /begin LOC_MEASUREMENT model.MainClass.servoController.edgeDetect.buffer model.MainClass.servoController.edgeDetect.oldSignal /end LOC_MEASUREMENT
/end FUNCTION
/begin FUNCTION model.Signals.ledRing[0] ""
 /begin LOC_MEASUREMENT model.Signals.ledRing[0].blue model.Signals.ledRing[0].green model.Signals.ledRing[0].red /end LOC_MEASUREMENT
/end FUNCTION
/begin FUNCTION model.Signals.ledRing[1] ""
 /begin LOC_MEASUREMENT model.Signals.ledRing[1].blue model.Signals.ledRing[1].green model.Signals.ledRing[1].red /end LOC_MEASUREMENT
/end FUNCTION
/begin FUNCTION model.Signals.ledRing[2] ""
 /begin LOC_MEASUREMENT model.Signals.ledRing[2].blue model.Signals.ledRing[2].green model.Signals.ledRing[2].red /end LOC_MEASUREMENT
/end FUNCTION
/begin FUNCTION model.Signals.ledRing[3] ""
 /begin LOC_MEASUREMENT model.Signals.ledRing[3].blue model.Signals.ledRing[3].green model.Signals.ledRing[3].red /end LOC_MEASUREMENT
/end FUNCTION
/begin FUNCTION model.Signals.ledRing[4] ""
 /begin LOC_MEASUREMENT model.Signals.ledRing[4].blue model.Signals.ledRing[4].green model.Signals.ledRing[4].red /end LOC_MEASUREMENT
/end FUNCTION
/begin FUNCTION model.Signals.ledRing[5] ""
 /begin LOC_MEASUREMENT model.Signals.ledRing[5].blue model.Signals.ledRing[5].green model.Signals.ledRing[5].red /end LOC_MEASUREMENT
/end FUNCTION
/begin FUNCTION model.Signals.ledRing[6] ""
 /begin LOC_MEASUREMENT model.Signals.ledRing[6].blue model.Signals.ledRing[6].green model.Signals.ledRing[6].red /end LOC_MEASUREMENT
/end FUNCTION
/begin FUNCTION model.Signals.ledRing[7] ""
 /begin LOC_MEASUREMENT model.Signals.ledRing[7].blue model.Signals.ledRing[7].green model.Signals.ledRing[7].red /end LOC_MEASUREMENT
/end FUNCTION
/begin FUNCTION model.Signals.ledRing[8] ""
 /begin LOC_MEASUREMENT model.Signals.ledRing[8].blue model.Signals.ledRing[8].green model.Signals.ledRing[8].red /end LOC_MEASUREMENT
/end FUNCTION
/begin FUNCTION model.Signals.ledRing[9] ""
 /begin LOC_MEASUREMENT model.Signals.ledRing[9].blue model.Signals.ledRing[9].green model.Signals.ledRing[9].red /end LOC_MEASUREMENT
/end FUNCTION
/begin FUNCTION model.Signals.ledRing[10] ""
 /begin LOC_MEASUREMENT model.Signals.ledRing[10].blue model.Signals.ledRing[10].green model.Signals.ledRing[10].red /end LOC_MEASUREMENT
/end FUNCTION
/begin FUNCTION model.Signals.ledRing[11] ""
 /begin LOC_MEASUREMENT model.Signals.ledRing[11].blue model.Signals.ledRing[11].green model.Signals.ledRing[11].red /end LOC_MEASUREMENT
/end FUNCTION
/begin RECORD_LAYOUT STANDARD_VALUE_R64 /* value */ FNC_VALUES 1 FLOAT64_IEEE COLUMN_DIR DIRECT /end RECORD_LAYOUT
/begin RECORD_LAYOUT STANDARD_VALUE_U8 /* value */ FNC_VALUES 1 UBYTE COLUMN_DIR DIRECT /end RECORD_LAYOUT
/begin GROUP model.MainClass "" ROOT
 /begin SUB_GROUP model.MainClass.gameController model.MainClass.ledController model.MainClass.servoController /end SUB_GROUP
/end GROUP
/begin GROUP model.MainClass.gameController ""
 /begin REF_CHARACTERISTIC model.MainClass.gameController.gameTime model.MainClass.gameController.scoringZone /end REF_CHARACTERISTIC
 /begin REF_MEASUREMENT model.MainClass.gameController.ballPosition model.MainClass.gameController.score model.MainClass.gameController.sm model.MainClass.gameController.startGame /end REF_MEASUREMENT
 /begin SUB_GROUP model.MainClass.gameController.timer model.MainClass.gameController.stopWatch model.MainClass.gameController.edgeDetect /end SUB_GROUP
/end GROUP
/begin GROUP model.MainClass.gameController.edgeDetect "EdgeRising detects a rising edge of the logical input signal."
 /begin REF_MEASUREMENT model.MainClass.gameController.edgeDetect.buffer model.MainClass.gameController.edgeDetect.oldSignal /end REF_MEASUREMENT
/end GROUP
/begin GROUP model.MainClass.gameController.stopWatch "StopWatch increments the time counter by one dT." /begin REF_MEASUREMENT model.MainClass.gameController.stopWatch.timeCounter /end REF_MEASUREMENT /end GROUP
/begin GROUP model.MainClass.gameController.timer "Timer decrements the time counter by dT and signals when the time counter has reached zero. It is not retriggerable." /begin REF_MEASUREMENT model.MainClass.gameController.timer.timeCounter /end REF_MEASUREMENT /end GROUP
/begin GROUP model.MainClass.ledController ""
 /begin REF_MEASUREMENT model.MainClass.ledController.fadeValue model.MainClass.ledController.gameState model.MainClass.ledController.gameTime model.MainClass.ledController.sm /end REF_MEASUREMENT
 /begin SUB_GROUP model.MainClass.ledController.ledRing[0] model.MainClass.ledController.ledRing[1] model.MainClass.ledController.ledRing[2] model.MainClass.ledController.ledRing[3] model.MainClass.ledController.ledRing[4] model.MainClass.ledController.ledRing[5] model.MainClass.ledController.ledRing[6] model.MainClass.ledController.ledRing[7] model.MainClass.ledController.ledRing[8] model.MainClass.ledController.ledRing[9] model.MainClass.ledController.ledRing[10] model.MainClass.ledController.ledRing[11] model.MainClass.ledController.sw /end SUB_GROUP
/end GROUP
/begin GROUP model.MainClass.ledController.ledRing[0] ""
 /begin REF_MEASUREMENT model.MainClass.ledController.ledRing[0].blue model.MainClass.ledController.ledRing[0].green model.MainClass.ledController.ledRing[0].red /end REF_MEASUREMENT
/end GROUP
/begin GROUP model.MainClass.ledController.ledRing[10] ""
 /begin REF_MEASUREMENT model.MainClass.ledController.ledRing[10].blue model.MainClass.ledController.ledRing[10].green model.MainClass.ledController.ledRing[10].red /end REF_MEASUREMENT
/end GROUP
/begin GROUP model.MainClass.ledController.ledRing[11] ""
 /begin REF_MEASUREMENT model.MainClass.ledController.ledRing[11].blue model.MainClass.ledController.ledRing[11].green model.MainClass.ledController.ledRing[11].red /end REF_MEASUREMENT
/end GROUP
/begin GROUP model.MainClass.ledController.ledRing[1] ""
 /begin REF_MEASUREMENT model.MainClass.ledController.ledRing[1].blue model.MainClass.ledController.ledRing[1].green model.MainClass.ledController.ledRing[1].red /end REF_MEASUREMENT
/end GROUP
/begin GROUP model.MainClass.ledController.ledRing[2] ""
 /begin REF_MEASUREMENT model.MainClass.ledController.ledRing[2].blue model.MainClass.ledController.ledRing[2].green model.MainClass.ledController.ledRing[2].red /end REF_MEASUREMENT
/end GROUP
/begin GROUP model.MainClass.ledController.ledRing[3] ""
 /begin REF_MEASUREMENT model.MainClass.ledController.ledRing[3].blue model.MainClass.ledController.ledRing[3].green model.MainClass.ledController.ledRing[3].red /end REF_MEASUREMENT
/end GROUP
/begin GROUP model.MainClass.ledController.ledRing[4] ""
 /begin REF_MEASUREMENT model.MainClass.ledController.ledRing[4].blue model.MainClass.ledController.ledRing[4].green model.MainClass.ledController.ledRing[4].red /end REF_MEASUREMENT
/end GROUP
/begin GROUP model.MainClass.ledController.ledRing[5] ""
 /begin REF_MEASUREMENT model.MainClass.ledController.ledRing[5].blue model.MainClass.ledController.ledRing[5].green model.MainClass.ledController.ledRing[5].red /end REF_MEASUREMENT
/end GROUP
/begin GROUP model.MainClass.ledController.ledRing[6] ""
 /begin REF_MEASUREMENT model.MainClass.ledController.ledRing[6].blue model.MainClass.ledController.ledRing[6].green model.MainClass.ledController.ledRing[6].red /end REF_MEASUREMENT
/end GROUP
/begin GROUP model.MainClass.ledController.ledRing[7] ""
 /begin REF_MEASUREMENT model.MainClass.ledController.ledRing[7].blue model.MainClass.ledController.ledRing[7].green model.MainClass.ledController.ledRing[7].red /end REF_MEASUREMENT
/end GROUP
/begin GROUP model.MainClass.ledController.ledRing[8] ""
 /begin REF_MEASUREMENT model.MainClass.ledController.ledRing[8].blue model.MainClass.ledController.ledRing[8].green model.MainClass.ledController.ledRing[8].red /end REF_MEASUREMENT
/end GROUP
/begin GROUP model.MainClass.ledController.ledRing[9] ""
 /begin REF_MEASUREMENT model.MainClass.ledController.ledRing[9].blue model.MainClass.ledController.ledRing[9].green model.MainClass.ledController.ledRing[9].red /end REF_MEASUREMENT
/end GROUP
/begin GROUP model.MainClass.ledController.sw "StopWatch increments the time counter by one dT." /begin REF_MEASUREMENT model.MainClass.ledController.sw.timeCounter /end REF_MEASUREMENT /end GROUP
/begin GROUP model.MainClass.servoController ""
 /begin REF_CHARACTERISTIC model.MainClass.servoController.kp model.MainClass.servoController.ki model.MainClass.servoController.kd /end REF_CHARACTERISTIC
 /begin REF_MEASUREMENT model.MainClass.servoController.ballPosition model.MainClass.servoController.doIntegrate model.MainClass.servoController.error model.MainClass.servoController.gameState model.MainClass.servoController.handPosition model.MainClass.servoController.integral model.MainClass.servoController.lastValue model.MainClass.servoController.servoPosition model.MainClass.servoController.sm model.MainClass.servoController.switchMode /end REF_MEASUREMENT
 /begin SUB_GROUP model.MainClass.servoController.edgeDetect /end SUB_GROUP
/end GROUP
/begin GROUP model.MainClass.servoController.edgeDetect "EdgeRising detects a rising edge of the logical input signal."
 /begin REF_MEASUREMENT model.MainClass.servoController.edgeDetect.buffer model.MainClass.servoController.edgeDetect.oldSignal /end REF_MEASUREMENT
/end GROUP
/begin GROUP model.Signals "" ROOT
 /begin REF_MEASUREMENT model.Signals.adcHandPosition model.Signals.autoModeButton model.Signals.ballPosition model.Signals.handPosition model.Signals.score model.Signals.servoPosition model.Signals.startGameButton /end REF_MEASUREMENT
 /begin SUB_GROUP model.Signals.ledRing[0] model.Signals.ledRing[1] model.Signals.ledRing[2] model.Signals.ledRing[3] model.Signals.ledRing[4] model.Signals.ledRing[5] model.Signals.ledRing[6] model.Signals.ledRing[7] model.Signals.ledRing[8] model.Signals.ledRing[9] model.Signals.ledRing[10] model.Signals.ledRing[11] /end SUB_GROUP
/end GROUP
/begin GROUP model.Signals.ledRing[0] ""
 /begin REF_MEASUREMENT model.Signals.ledRing[0].blue model.Signals.ledRing[0].green model.Signals.ledRing[0].red /end REF_MEASUREMENT
/end GROUP
/begin GROUP model.Signals.ledRing[10] ""
 /begin REF_MEASUREMENT model.Signals.ledRing[10].blue model.Signals.ledRing[10].green model.Signals.ledRing[10].red /end REF_MEASUREMENT
/end GROUP
/begin GROUP model.Signals.ledRing[11] ""
 /begin REF_MEASUREMENT model.Signals.ledRing[11].blue model.Signals.ledRing[11].green model.Signals.ledRing[11].red /end REF_MEASUREMENT
/end GROUP
/begin GROUP model.Signals.ledRing[1] ""
 /begin REF_MEASUREMENT model.Signals.ledRing[1].blue model.Signals.ledRing[1].green model.Signals.ledRing[1].red /end REF_MEASUREMENT
/end GROUP
/begin GROUP model.Signals.ledRing[2] ""
 /begin REF_MEASUREMENT model.Signals.ledRing[2].blue model.Signals.ledRing[2].green model.Signals.ledRing[2].red /end REF_MEASUREMENT
/end GROUP
/begin GROUP model.Signals.ledRing[3] ""
 /begin REF_MEASUREMENT model.Signals.ledRing[3].blue model.Signals.ledRing[3].green model.Signals.ledRing[3].red /end REF_MEASUREMENT
/end GROUP
/begin GROUP model.Signals.ledRing[4] ""
 /begin REF_MEASUREMENT model.Signals.ledRing[4].blue model.Signals.ledRing[4].green model.Signals.ledRing[4].red /end REF_MEASUREMENT
/end GROUP
/begin GROUP model.Signals.ledRing[5] ""
 /begin REF_MEASUREMENT model.Signals.ledRing[5].blue model.Signals.ledRing[5].green model.Signals.ledRing[5].red /end REF_MEASUREMENT
/end GROUP
/begin GROUP model.Signals.ledRing[6] ""
 /begin REF_MEASUREMENT model.Signals.ledRing[6].blue model.Signals.ledRing[6].green model.Signals.ledRing[6].red /end REF_MEASUREMENT
/end GROUP
/begin GROUP model.Signals.ledRing[7] ""
 /begin REF_MEASUREMENT model.Signals.ledRing[7].blue model.Signals.ledRing[7].green model.Signals.ledRing[7].red /end REF_MEASUREMENT
/end GROUP
/begin GROUP model.Signals.ledRing[8] ""
 /begin REF_MEASUREMENT model.Signals.ledRing[8].blue model.Signals.ledRing[8].green model.Signals.ledRing[8].red /end REF_MEASUREMENT
/end GROUP
/begin GROUP model.Signals.ledRing[9] ""
 /begin REF_MEASUREMENT model.Signals.ledRing[9].blue model.Signals.ledRing[9].green model.Signals.ledRing[9].red /end REF_MEASUREMENT
/end GROUP
/begin GROUP simulation.Stimulator "" ROOT
 /begin REF_CHARACTERISTIC simulation.Stimulator.handPosition simulation.Stimulator.startGameButton simulation.Stimulator.autoModeButton simulation.Stimulator.velocityCoefficient /end REF_CHARACTERISTIC
 /begin REF_MEASUREMENT simulation.Stimulator.ballPosition simulation.Stimulator.leftEdge simulation.Stimulator.rightEdge /end REF_MEASUREMENT
/end GROUP
/end MODULE
/end PROJECT
